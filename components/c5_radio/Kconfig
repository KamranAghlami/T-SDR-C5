## components/c5_radio/Kconfig
```kconfig
menu "t-sdr-c5 radio"

    config C5_RADIO_STOCK_CAPTURE
        bool "Use the vendor adctrig() capture path"
        default n
        help
            Capture through the stock RF test routine, as ESP-SDR does. It adds
            about 1.7 ms per snapshot. The default register-level engine
            (ported from ESPsoup) produces the same samples without that stall.

endmenu
```

## main/Kconfig.projbuild
```kconfig
menu "t-sdr-c5"

    config T_SDR_C5_STATS_LOG
        bool "Log capture statistics once per second"
        default n
        help
            Prints lines/s, captures per line, per-phase timing, failures,
            recalibrations, gain and battery readings to the console every
            second. Useful for measurements; off in release builds.

endmenu
```
